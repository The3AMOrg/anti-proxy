## CMakeLists.txt
```
cmake_minimum_required(VERSION 3.13.1)

include($ENV{ZEPHYR_BASE}/cmake/app/boilerplate.cmake NO_POLICY_SCOPE)
project(pairing_lesecure_numeric_comparison)

zephyr_include_directories_ifdef(CONFIG_BOARD_NRF52840_PCA10056
   $ENV{ZEPHYR_BASE}/boards/arm/nrf52840_pca10056)

FILE(GLOB app_sources src/*.c)
target_sources(app PRIVATE
  ${app_sources}
    src/services/custom_service.c
    src/utils/rssi.c
  )

zephyr_library_include_directories(src)
```

## prj.conf
```kconfig
CONFIG_BT=y
# needed to ensure keys are persisted
CONFIG_FLASH=y
CONFIG_FLASH_PAGE_LAYOUT=y
CONFIG_FLASH_MAP=y
CONFIG_FCB=y
CONFIG_SETTINGS=y
CONFIG_BT_SETTINGS=y

CONFIG_BT_DEBUG_LOG=y
CONFIG_BT_SMP=y
CONFIG_BT_PERIPHERAL=y
CONFIG_BT_DIS=y
CONFIG_BT_DIS_PNP=n
CONFIG_BT_GATT_DYNAMIC_DB=y
CONFIG_BT_DEVICE_NAME="NCLECAUT"

# enable the possibility of LE Secure Connections
CONFIG_BT_TINYCRYPT_ECC=y

# specify Secure Connections Only mode
CONFIG_BT_SMP_SC_ONLY=y

CONFIG_SYSTEM_WORKQUEUE_STACK_SIZE=2200

# enable RSSI in the controller
CONFIG_BT_CTLR_CONN_RSSI=y
CONFIG_BT_CTLR_ADVANCED_FEATURES=y

# Input Output capabilities
CONFIG_CONSOLE=y
CONFIG_GPIO=y

CONFIG_BT_DIS=n
```

## src/main.c
```c
#include <zephyr/types.h>
#include <stddef.h>
#include <string.h>
#include <errno.h>
#include <zephyr.h>
#include <device.h>
#include <drivers/gpio.h>

#include <bluetooth/bluetooth.h>
#include <bluetooth/hci.h>
#include <bluetooth/conn.h>
#include <bluetooth/uuid.h>
#include <bluetooth/gatt.h>
#include <settings/settings.h>

#include <services/custom_service.h>
#include <utils/rssi.h>

// RSSI samplimg
struct k_work_delayable rssi_timer;

int sampling = 0;

// GPIO for the buttons

// Button 1
#define SW0_NODE	DT_ALIAS(sw0)
#if !DT_NODE_HAS_STATUS(SW0_NODE, okay)
#error "Unsupported board: sw0 devicetree alias is not defined"
#endif
static const struct gpio_dt_spec button1 = GPIO_DT_SPEC_GET_OR(SW0_NODE, gpios,
							      {0});

#ifndef SW0_GPIO_FLAGS
#ifdef SW0_GPIO_PIN_PUD
#define SW0_GPIO_FLAGS SW0_GPIO_PIN_PUD
#else
#define SW0_GPIO_FLAGS 0
#endif
#endif

// Button 2
#define SW1_NODE	DT_ALIAS(sw1)
#if !DT_NODE_HAS_STATUS(SW1_NODE, okay)
#error "Unsupported board: sw1 devicetree alias is not defined"
#endif
static const struct gpio_dt_spec button2 = GPIO_DT_SPEC_GET_OR(SW1_NODE, gpios,
							      {0});

#ifndef SW1_GPIO_FLAGS
#ifdef SW1_GPIO_PIN_PUD
#define SW1_GPIO_FLAGS SW1_GPIO_PIN_PUD
#else
#define SW1_GPIO_FLAGS 0
#endif
#endif

static struct gpio_callback gpio_btnA_cb;
static struct gpio_callback gpio_btnB_cb;
static struct k_work buttonA_work;
static struct k_work buttonB_work;

#define DEVICE_NAME CONFIG_BT_DEVICE_NAME
#define DEVICE_NAME_LEN (sizeof(DEVICE_NAME) - 1)

bool authenticating = false;

struct bt_conn *default_conn;

static const struct bt_data ad[] = {
		BT_DATA_BYTES(BT_DATA_FLAGS, (BT_LE_AD_GENERAL | BT_LE_AD_NO_BREDR)),
		BT_DATA(BT_DATA_NAME_COMPLETE, DEVICE_NAME, DEVICE_NAME_LEN),
};

// passkey is generated by the stack and provided in callback for display to the user
static void pairing_passkey_display(struct bt_conn *conn, unsigned int passkey)
{
	char addr[BT_ADDR_LE_STR_LEN];
	bt_addr_le_to_str(bt_conn_get_dst(conn), addr, sizeof(addr));
	printk("Passkey for %s: %06u\n", addr, passkey);
}

static void auth_confirm(struct bt_conn *conn, unsigned int passkey)
{
	default_conn = conn;
	char addr[BT_ADDR_LE_STR_LEN];
	char passkey_str[7];
	bt_addr_le_to_str(bt_conn_get_dst(conn), addr, sizeof(addr));
	snprintk(passkey_str, 7, "%06u", passkey);
	printk("\nConfirm passkey for %s: %s\n\n", addr, passkey_str);
	printk("Press button A for YES or button B for NO\n");
	authenticating = true;
}


static void pairing_cancel(struct bt_conn *conn)
{
	printk("Pairing cancelled\n");
	authenticating = false;
}

// will result in Numeric Comparison being used
static struct bt_conn_auth_cb pairing_cb_display = {
		.passkey_display = pairing_passkey_display,
		.passkey_confirm = auth_confirm,
		.cancel = pairing_cancel,
};

void rssi_polling(struct k_work *work)
{
	read_rssi();
	// printk("RSSI READ WOULD HAPPEN HERE\n");

	// and again in a second....
	if (sampling == 1) {
	  k_work_schedule(&rssi_timer, K_SECONDS(1));
	}

}

void start_sampling_rssi()
{
	printk("starting RSSI sampling\n");
	sampling = 1;
    k_work_init_delayable(&rssi_timer, rssi_polling);
	k_work_schedule(&rssi_timer, K_SECONDS(1));
}

static void connected(struct bt_conn *conn, uint8_t err)
{
	if (err)
	{
	}
	else
	{
		printk("Connected\n");
		default_conn = bt_conn_ref(conn);
		int rc = bt_conn_set_security(default_conn, BT_SECURITY_L4);
		printk("requested security level 4 [%d]\n",rc);
    	start_sampling_rssi();
	}
}

static void disconnected(struct bt_conn *conn, uint8_t reason)
{
	if (default_conn)
	{
		bt_conn_unref(default_conn);
		default_conn = NULL;
    	sampling = 0;
	}
}

static void security_level_changed(struct bt_conn *conn, bt_security_t level, enum bt_security_err err)
{
	printk("security_level_changed to %d\n", level);
}

static struct bt_conn_cb conn_callbacks = {
		.connected = connected,
		.disconnected = disconnected,
		.security_changed = security_level_changed,
};

static void bt_ready(int err)
{
	if (err)
	{
		return;
	}

	custom_service_init();

	if (IS_ENABLED(CONFIG_SETTINGS))
	{
		settings_load();
	}

	err = bt_le_adv_start(BT_LE_ADV_CONN, ad, ARRAY_SIZE(ad), NULL, 0);
	if (err)
	{
		return;
	}
}
void buttonA_work_handler(struct k_work *work)
{
	if (!authenticating)
	{
		return;
	}
	printk("User indicated YES\n");
	bt_conn_auth_passkey_confirm(default_conn);
	authenticating = false;
}

void buttonB_work_handler(struct k_work *work)
{
	if (!authenticating)
	{
		return;
	}
	printk("User indicated NO\n");
	bt_conn_auth_cancel(default_conn);
	authenticating = false;
}

void button_A_pressed(const struct device *gpiob, struct gpio_callback *cb,
											uint32_t pins)
{
	printk("Button A pressed\n");
	if (!authenticating)
	{
		return;
	}
	k_work_submit(&buttonA_work);
}

void button_B_pressed(const struct device *gpiob, struct gpio_callback *cb,
											uint32_t pins)
{
	printk("Button B pressed\n");
	k_work_submit(&buttonB_work);
}

void configureButtons(void)
{
	int ret;

	// Button 1
	k_work_init(&buttonA_work, buttonA_work_handler);
	ret = gpio_pin_configure_dt(&button1, GPIO_INPUT);
	if (ret != 0) {
		printk("Error %d: failed to configure %s pin %d\n",
		       ret, button1.port->name, button1.pin);
		return;
	}

	ret = gpio_pin_interrupt_configure_dt(&button1,
					      GPIO_INT_EDGE_TO_ACTIVE);
	if (ret != 0) {
		printk("Error %d: failed to configure interrupt on %s pin %d\n",
			ret, button1.port->name, button1.pin);
		return;
	}

	gpio_init_callback(&gpio_btnA_cb, button_A_pressed, BIT(button1.pin));
	gpio_add_callback(button1.port, &gpio_btnA_cb);
	printk("Set up button at %s pin %d\n", button1.port->name, button1.pin);

	// Button 2
	k_work_init(&buttonB_work, buttonB_work_handler);
	ret = gpio_pin_configure_dt(&button2, GPIO_INPUT);
	if (ret != 0) {
		printk("Error %d: failed to configure %s pin %d\n",
		       ret, button2.port->name, button2.pin);
		return;
	}

	ret = gpio_pin_interrupt_configure_dt(&button2,
					      GPIO_INT_EDGE_TO_ACTIVE);
	if (ret != 0) {
		printk("Error %d: failed to configure interrupt on %s pin %d\n",
			ret, button2.port->name, button2.pin);
		return;
	}

	gpio_init_callback(&gpio_btnB_cb, button_B_pressed, BIT(button2.pin));
	gpio_add_callback(button2.port, &gpio_btnB_cb);
	printk("Set up button at %s pin %d\n", button2.port->name, button2.pin);
}

void clear_all_bonds()
{

	/** Clear pairing information.
  *
  * @param id    Local identity (mostly just BT_ID_DEFAULT).
  * @param addr  Remote address, NULL or BT_ADDR_LE_ANY to clear all remote
  *              devices.
  *
  * @return 0 on success or negative error value on failure.
  */
	printk("clearing all bonds\n");
	int rc = bt_unpair(BT_ID_DEFAULT, BT_ADDR_LE_ANY);
	printk("done [%d]\n", rc);
}

void main(void)
{

	printk("starting NCLECAUT\n");
	int err;
	configureButtons();
	err = bt_enable(bt_ready);
	if (err)
	{
		return;
	}

	clear_all_bonds();

	bt_conn_cb_register(&conn_callbacks);

	bt_conn_auth_cb_register(&pairing_cb_display);
}
```
