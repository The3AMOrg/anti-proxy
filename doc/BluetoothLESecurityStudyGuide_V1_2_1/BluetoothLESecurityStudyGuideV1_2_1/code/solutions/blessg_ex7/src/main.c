#include <zephyr/types.h>
#include <stddef.h>
#include <string.h>
#include <errno.h>
#include <zephyr.h>
#include <device.h>

#include <bluetooth/bluetooth.h>
#include <bluetooth/hci.h>
#include <bluetooth/conn.h>
#include <bluetooth/uuid.h>
#include <bluetooth/gatt.h>
#include <settings/settings.h>

#define DEVICE_NAME CONFIG_BT_DEVICE_NAME
#define DEVICE_NAME_LEN (sizeof(DEVICE_NAME) - 1)

struct bt_conn *default_conn;

static const struct bt_data ad[] = {
		BT_DATA_BYTES(BT_DATA_FLAGS, (BT_LE_AD_GENERAL | BT_LE_AD_NO_BREDR)),
		BT_DATA(BT_DATA_NAME_COMPLETE, DEVICE_NAME, DEVICE_NAME_LEN),
};

// passkey is generated by the stack and provided in callback for display to the user
static void pairing_passkey_display(struct bt_conn *conn, unsigned int passkey)
{
	char addr[BT_ADDR_LE_STR_LEN];
	bt_addr_le_to_str(bt_conn_get_dst(conn), addr, sizeof(addr));
	printk("Passkey for %s: %06u\n", addr, passkey);
}

static void auth_cancel(struct bt_conn *conn)
{
	printk("Pairing cancelled\n");
}

// callbacks for pairing - IO Capabilities are implied from this struct
static struct bt_conn_auth_cb pairing_cb_display = {
		.passkey_display = pairing_passkey_display,
		.passkey_entry = NULL,
		.cancel = auth_cancel,
};

static void connected(struct bt_conn *conn, uint8_t err)
{
	if (err)
	{
	}
	else
	{
		printk("Connected\n");
		default_conn = bt_conn_ref(conn);

		// Encryption and authentication using the LE Secure Connections feature available since Bluetooth 4.2.
		int rc = bt_conn_set_security(default_conn, BT_SECURITY_L4);
	}
}

static void disconnected(struct bt_conn *conn, uint8_t reason)
{
	if (default_conn)
	{
		bt_conn_unref(default_conn);
		default_conn = NULL;
	}
}

static void security_level_changed(struct bt_conn *conn, bt_security_t level, enum bt_security_err err)
{
	printk("security_level_changed to %d\n", level);
}

static struct bt_conn_cb conn_callbacks = {
		.connected = connected,
		.disconnected = disconnected,
		.security_changed = security_level_changed,
};

static void bt_ready(int err)
{
	if (err)
	{
		return;
	}

	int rc = settings_load();
	printk("settings_load result: %d\n",rc);

	err = bt_le_adv_start(BT_LE_ADV_CONN, ad, ARRAY_SIZE(ad), NULL, 0);
	if (err)
	{
		return;
	}

}

void clear_all_bonds()
{

	/** Clear pairing information.
  *
  * @param id    Local identity (mostly just BT_ID_DEFAULT).
  * @param addr  Remote address, NULL or BT_ADDR_LE_ANY to clear all remote
  *              devices.
  *
  * @return 0 on success or negative error value on failure.
  */
	int rc = bt_unpair(BT_ID_DEFAULT, BT_ADDR_LE_ANY);
}

void main(void)
{

	printk("starting PK_LEC_PRIV\n");

	int err;

	err = bt_enable(bt_ready);
	if (err)
	{
		return;
	}

	clear_all_bonds();
	bt_conn_cb_register(&conn_callbacks);
	bt_conn_auth_cb_register(&pairing_cb_display);
}
